#include "HugoUI_User.h"
#include "Hugo_UI.h"
#include "HugoUI_BMP.h"
#include "u8g2.h"
#include "OLED_User.h"
#include "malloc.h"
#include "oled.h"
#include "BEEPER.h"
#include "usart.h"

#include "FileSystem.h"


/******************************图片存放区******************************/
const uint8_t Setting_BMP[] = {
    0x00, 0x00, 0x00, 0x00, 0x00, 0x00, 0x00, 0x00, 0xE0, 0x0F, 0x00, 0x00, 0xE0, 0x0F, 0x00, 0x00,
    0x7C, 0xFC, 0xFF, 0x3F, 0x7C, 0xFC, 0xFF, 0x3F, 0x7C, 0xFC, 0xFF, 0x3F, 0xE0, 0x0F, 0x00, 0x00,
    0xE0, 0x0F, 0x00, 0x00, 0x00, 0x00, 0x00, 0x00, 0x00, 0x00, 0x00, 0x00, 0x00, 0x00, 0x00, 0x00,
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    0x00, 0xF0, 0x07, 0x00, 0x00, 0xF0, 0x07, 0x00, 0x00, 0x00, 0x00, 0x00, 0x00, 0x00, 0x00, 0x00,
    /* 32*32 */
};

const uint8_t Poet_BMP[] = {
    0x00, 0x00, 0x00, 0x00, 0x00, 0x00, 0x00, 0x00, 0x00, 0x00, 0x00, 0x00, 0x00, 0x00, 0x00, 0x00,
    0x00, 0x00, 0x00, 0x00, 0x00, 0x00, 0x7E, 0x00, 0x00, 0x00, 0x7E, 0x00, 0x00, 0x80, 0xE7, 0x01,
    0x00, 0x80, 0xE7, 0x01, 0x00, 0xE0, 0x81, 0x07, 0x00, 0xE0, 0x81, 0x07, 0x00, 0x78, 0x18, 0x06,
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    0x18, 0x00, 0x00, 0x00, 0x00, 0x00, 0x00, 0x00, 0x00, 0x00, 0x00, 0x00, 0x00, 0x00, 0x00, 0x00,
    /* 32*32 */
};

const u8 Robot_BMP[] = {
    0x00, 0x00, 0x00, 0x00, 0x00, 0x00, 0x00, 0x00, 0x00, 0x00, 0x00, 0x00, 0x00, 0x00, 0x00, 0x00,
    0x00, 0xE0, 0x03, 0x00, 0x00, 0xE0, 0x03, 0x00, 0x00, 0xE0, 0x03, 0x00, 0x00, 0xE0, 0x03, 0x00,
    0x00, 0xE0, 0x03, 0x00, 0x00, 0xE0, 0x03, 0x00, 0x80, 0xFF, 0xFF, 0x00, 0x80, 0xFF, 0xFF, 0x00,
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    0x00, 0x00, 0x00, 0x00, 0x00, 0x00, 0x00, 0x00, 0x00, 0x00, 0x00, 0x00, 0x00, 0x00, 0x00, 0x00,
    /* 32*32 */

};

const u8 Knife_BMP[] = {
    0x00, 0x00, 0x00, 0x00, 0x00, 0x00, 0x00, 0x00, 0x00, 0x00, 0x00, 0x00, 0x00, 0x60, 0xE0, 0x07,
    0x00, 0x60, 0xE0, 0x07, 0x00, 0x60, 0x18, 0x18, 0x00, 0x60, 0x18, 0x18, 0x80, 0x61, 0x06, 0x18,
    0x80, 0x61, 0x06, 0x18, 0x00, 0x86, 0x01, 0x18, 0x00, 0x86, 0x01, 0x18, 0x00, 0x00, 0x00, 0x06,
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    0xE0, 0x07, 0x06, 0x00, 0x00, 0x00, 0x00, 0x00, 0x00, 0x00, 0x00, 0x00, 0x00, 0x00, 0x00, 0x00,
    /* 32*32 */
};

const u8 Lighting_BMP[] = {
    0x00, 0x00, 0x00, 0x00, 0x00, 0x00, 0x00, 0x00, 0x00, 0x00, 0x00, 0x00, 0x00, 0x00, 0x30, 0x00,
    0x00, 0x00, 0x30, 0x00, 0x00, 0x00, 0x3C, 0x00, 0x00, 0x00, 0x3C, 0x00, 0x00, 0x00, 0x0B, 0x00,
    0x00, 0x00, 0x0B, 0x00, 0x00, 0xC0, 0x08, 0x00, 0x00, 0xC0, 0x08, 0x00, 0x00, 0x30, 0x08, 0x00,
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    0x00, 0x06, 0x00, 0x00, 0x00, 0x00, 0x00, 0x00, 0x00, 0x00, 0x00, 0x00, 0x00, 0x00, 0x00, 0x00,
    /* 32*32 */
};

const u8 Cuteghost_BMP[] = {
    0x00, 0x00, 0x00, 0x00, 0x00, 0x00, 0x00, 0x00, 0x00, 0x00, 0x00, 0x00, 0x00, 0x00, 0x00, 0x00,
    0x00, 0x7E, 0x00, 0x00, 0x80, 0xFF, 0x00, 0x00, 0xE0, 0xFF, 0x03, 0x00, 0xF0, 0xFF, 0x07, 0x00,
    0xF8, 0xCF, 0x06, 0x00, 0xFC, 0xCF, 0x0C, 0x00, 0xD4, 0xFF, 0x0D, 0x00, 0xC0, 0x3F, 0x0F, 0x00,
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    0xFF, 0xFF, 0x03, 0x00, 0xFF, 0xFF, 0x03, 0x00, 0xFF, 0xFF, 0x03, 0x00, 0xFF, 0xFF, 0x03, 0x00,
    /* 32*32 */

};

const u8 Myself_BMP[] = {
    0x00, 0x00, 0x00, 0x00, 0x00, 0x00, 0x00, 0x00, 0x00, 0x00, 0x00, 0x00, 0x00, 0x00, 0x00, 0x00,
    0x00, 0x00, 0x00, 0x00, 0x00, 0x00, 0x00, 0x00, 0x00, 0x00, 0x00, 0x00, 0x00, 0x04, 0x00, 0x00,
    0x80, 0x04, 0x00, 0x00, 0x00, 0x01, 0x00, 0x00, 0x00, 0x00, 0x00, 0x00, 0x60, 0x00, 0x00, 0x00,
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    0x20, 0x10, 0x08, 0x04, 0x20, 0x00, 0x00, 0x04, 0x40, 0x00, 0x00, 0x02, 0x80, 0x00, 0x00, 0x01,
    /* 32*32 */
};

const u8 SolidHreat_BMP[] = {
    0x00, 0x00, 0x00, 0x00, 0x00, 0x00, 0x00, 0x00, 0x00, 0x00, 0x00, 0x00, 0x80, 0x0F, 0xF0, 0x01,
    0xE0, 0x3F, 0xFC, 0x07, 0xE0, 0x3F, 0xFC, 0x07, 0xF0, 0x7F, 0xFE, 0x0F, 0xFC, 0xFF, 0xFF, 0x3F,
    0xFC, 0xFF, 0xFF, 0x3F, 0xFC, 0xFF, 0xFF, 0x3F, 0xFC, 0xFF, 0xFF, 0x3F, 0xFC, 0xFF, 0xFF, 0x3F,
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    0x00, 0x80, 0x01, 0x00, 0x00, 0x80, 0x01, 0x00, 0x00, 0x00, 0x00, 0x00, 0x00, 0x00, 0x00, 0x00,
    /* 32*32 */
};

const u8 HollowHreat_BMP[] = {
    0x00, 0x00, 0x00, 0x00, 0x00, 0x00, 0x00, 0x00, 0x00, 0x00, 0x00, 0x00, 0x00, 0x00, 0x00, 0x00,
    0x00, 0x00, 0x00, 0x00, 0xC0, 0x0F, 0xF0, 0x03, 0xC0, 0x0F, 0x00, 0x00, 0xF0, 0x3F, 0xFC, 0x0F,
    0xF0, 0x3F, 0x00, 0x00, 0xFC, 0xFF, 0xFF, 0x3F, 0xFC, 0xFF, 0x00, 0x00, 0xFC, 0xFF, 0xFF, 0x3F,
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    0x00, 0x00, 0x00, 0x00, 0x00, 0x00, 0x00, 0x00, 0x00, 0x00, 0x00, 0x00, 0x00, 0x00, 0x00, 0x00,
    /* 32*32 */
};

const u8 Unicorn_BMP[] = {
    0x00, 0x00, 0x00, 0x00, 0x00, 0x00, 0x00, 0x00, 0x00, 0x00, 0x00, 0x00, 0x00, 0x00, 0x00, 0x00,
    0x00, 0x00, 0x00, 0x00, 0x00, 0x00, 0x00, 0x00, 0x00, 0x00, 0x0C, 0x0C, 0x00, 0x00, 0x0C, 0x0C,
    0x00, 0x00, 0xCF, 0x03, 0x00, 0x00, 0xCF, 0x03, 0x00, 0xFC, 0xFF, 0x03, 0x00, 0xFC, 0xFF, 0x03,
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    0x00, 0x00, 0x00, 0x00, 0x00, 0x00, 0x00, 0x00, 0x00, 0x00, 0x00, 0x00, 0x00, 0x00, 0x00, 0x00,
    /* 32*32 */
};

const u8 Home_BMP[] = {
    0x00, 0x00, 0x00, 0x00, 0x00, 0x00, 0x00, 0x00, 0x00, 0x00, 0x00, 0x00, 0x00, 0x00, 0x00, 0x00,
    0x00, 0x00, 0x00, 0x00, 0x00, 0x00, 0x00, 0x00, 0x00, 0x00, 0x00, 0x00, 0x00, 0x00, 0x00, 0x00,
    0x00, 0xF0, 0x03, 0x00, 0x00, 0xF0, 0x03, 0x00, 0x00, 0xFC, 0x0F, 0x00, 0x00, 0xFC, 0x0F, 0x00,
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    0x00, 0x00, 0x00, 0x00, 0x00, 0x00, 0x00, 0x00, 0x00, 0x00, 0x00, 0x00, 0x00, 0x00, 0x00, 0x00,
    /* 32*32 */
};

const u8 TreasureBox_BMP[] = {
    0x00, 0x00, 0x00, 0x00, 0x00, 0x00, 0x00, 0x00, 0x00, 0x00, 0x00, 0x00, 0x00, 0x00, 0x00, 0x00,
    0xF0, 0xFF, 0xFF, 0x0F, 0xF0, 0xFF, 0xFF, 0x0F, 0x0C, 0x03, 0x00, 0x30, 0x0C, 0x03, 0x00, 0x30,
    0x03, 0x0C, 0x00, 0xC0, 0x03, 0x0C, 0x00, 0xC0, 0x03, 0x0C, 0x00, 0xC0, 0x03, 0x0C, 0x00, 0xC0,
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    0xFC, 0xFF, 0xFF, 0x3F, 0xFC, 0xFF, 0xFF, 0x3F, 0x00, 0x00, 0x00, 0x00, 0x00, 0x00, 0x00, 0x00,
    /* 32*32 */
};

const u8 HeadSculpture_BMP[] = {
    0xD6, 0xF8, 0xFF, 0xE7, 0x1F, 0x4B, 0xFC, 0xFF, 0x8C, 0x3F, 0x17, 0xC8, 0x7F, 0x10, 0x3A, 0x0F,
    0x80, 0xFF, 0x00, 0x30, 0x8F, 0xD3, 0xFF, 0x4D, 0x70, 0xE7, 0xEF, 0xFF, 0xFB, 0x76, 0xF7, 0xFF,
    0xFF, 0xFF, 0x7D, 0xFB, 0xFF, 0xFB, 0xFF, 0xFF, 0xFF, 0xFF, 0xFB, 0xFF, 0xFF, 0xFF, 0xFF, 0xF9,
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    0x04, 0x03, 0x00, 0x14, 0x62, 0x02, 0x01, 0x00, 0x08, 0x82,
    /* 40*50 */
};

/******************************图片存放区******************************/

/******************************变量存放区******************************/

// ui控制变量
extern uint8_t ui_Key_num, ui_Encoder_num; // user可以将自己的实现函数的变量直接赋值给这两个Num

// 开关控件变量
uint8_t SmoothAnimation_Flag = true; // 缓动动画标志位 // 缓动动画flag需要在HugoUI_Control中使用，建议不要改动！（don't change this one!!!）
uint8_t OptionStripFixedLength_Flag = false;

uint8_t InverseColor_flag = false; // oled屏幕反色（白色）标志位

uint8_t BeeperEnable_flag = true;
uint8_t PageListMode_flag = false;
uint8_t SetScreenFlip_flag = false;

// 滑动条变量
float frame_y_speed = 95;
float frame_x_speed = 105;
float frame_width_speed = 85;
float slidbar_y_speed = 65;
float page_x_foricon_speed = 105;
float page_y_forlist_speed = 90;

paramType WS2812_R = 10.0f;
paramType WS2812_G = 10.0f;
paramType WS2812_B = 10.0f;

paramType val1 = 0.1f;
paramType val2 = 0.2f;
paramType val3 = 0.3f;

paramType BeeperLoud = 0;

paramType ScreenBrightness = 255;
paramType MenuScroll = 0;

extern float icon_move_x;
extern u8g2_t u8g2;
/******************************变量存放区******************************/

/******************************结构体存放区******************************/

// 由于sizeof的原理是在编译阶段由编译器替换数组大小，因此我们无法计算指针的sizeof！需要在位图的第一个字节填写 n 阶矩阵图像

uint8_t *Switch_space[] = {
    &SmoothAnimation_Flag, // 缓动动画flag需要在HugoUI_Control中使用，建议不要改动！（don't change this one!!!）
    &OptionStripFixedLength_Flag,
    &InverseColor_flag,
    &Beeper0.Beeper_Enable, // 蜂鸣器使能标志位
    &PageListMode_flag,
    &SetScreenFlip_flag,

};

/**
 *    @结构体 Slide_Bar Slide_space[]
 *    @brief 滑动条控件 用于存储滑动条控件的值(即储存param)
 *    @param none
 *
 *    @变量
 *        int   val    值
 *        int   min  最小值
 *        int   max  最大值
 *        int   step 步进
 */

struct Slide_Bar Slide_space[] = {
    /* ---------- 屏幕亮度变量 ---------- */
    {(float *)&ScreenBrightness, 1, 255, 16}, // 亮度调整

    /* ---------- 动画速度变量 ---------- */
    {(float *)&frame_x_speed, 20, 200, 1},
    {(float *)&frame_y_speed, 20, 200, 1},
    {(float *)&frame_width_speed, 20, 200, 1},
    {(float *)&slidbar_y_speed, 20, 200, 1},
    {(float *)&page_y_forlist_speed, 20, 200, 1},
    {(float *)&page_x_foricon_speed, 20, 200, 1},

    /* ---------- 用户设置变量 ---------- */
    {(float *)&WS2812_R, 0, 255, 1}, // WS2812
    {(float *)&WS2812_G, 0, 255, 1},
    {(float *)&WS2812_B, 0, 255, 1},

    {(float *)&val1, 0, 10, 0.1}, // param
    {(float *)&val2, 0, 10, 0.5},
    {(float *)&val3, 0, 10, 0.1},

    {(float *)&BeeperLoud, 0, 88, 5}, // 蜂鸣器响度

};

/******************************结构体存放区******************************/

void HugoUI_InitLayout(void)
{
    /* 注册 Page */
    HugoUIPage_t *pageMain = AddPage(PAGE_CUSTOM, "pageMain");
    HugoUIPage_t *pageSetting = AddPage(PAGE_LIST, "pageSetting");
    HugoUIPage_t *pagePID = AddPage(PAGE_LIST, "pagePID");
    HugoUIPage_t *pageAnimation = AddPage(PAGE_LIST, "pageAnimation");
    HugoUIPage_t *pageWS2812 = AddPage(PAGE_LIST, "pageWS2812");

    /* 注册 Item */
    // PageMain
    pageMain->AddItem(pageMain, "Setting", ITEM_JUMP_PAGE)
        ->SetJumpId(pageSetting->pageId, 0)
        ->SetIconSrc(Setting_BMP);

    pageMain->AddItem(pageMain, "Oximeter", ITEM_CALL_FUNCTION, EventPulseOximeter)
        ->SetIconSrc(HollowHreat_BMP);

    pageMain->AddItem(pageMain, "Animation", ITEM_JUMP_PAGE)
        ->SetJumpId(pageAnimation->pageId, 0)
        ->SetIconSrc(Lighting_BMP);

    pageMain->AddItem(pageMain, "Servo", ITEM_CHECKBOX, NULL, NULL)
        ->SetIconSrc(Robot_BMP);

    pageMain->AddItem(pageMain, "Gyro", ITEM_CALL_FUNCTION, EventShowGyroUI)
        ->SetIconSrc(Poet_BMP);

    pageMain->AddItem(pageMain, "HelloHope", ITEM_CALL_FUNCTION, EventBlueTeeth)
        ->SetIconSrc(Knife_BMP);

    pageMain->AddItem(pageMain, "Cuteghost", ITEM_CALL_FUNCTION, EventChartTest)
        ->SetIconSrc(Cuteghost_BMP);

    pageMain->AddItem(pageMain, "Unicorn", ITEM_JUMP_PAGE)
        ->SetJumpId(pageWS2812->pageId, 0)
        ->SetIconSrc(Unicorn_BMP);

    pageMain->AddItem(pageMain, "???", ITEM_CALL_FUNCTION, EventTreasureBox)
        ->SetIconSrc(TreasureBox_BMP);

    pageMain->AddItem(pageMain, "About", ITEM_CALL_FUNCTION, EventShowAboutUI)
        ->SetIconSrc(Home_BMP);

    // PageSetting
    pageSetting->AddItem(pageSetting, "Setting", ITEM_PAGE_DESCRIPTION);
    pageSetting->AddItem(pageSetting, "PID Editor", ITEM_JUMP_PAGE)
        ->SetJumpId(pagePID->pageId, 0);

    pageSetting->AddItem(pageSetting, "InverseColor", ITEM_SWITCH, &InverseColor_flag, Oled_EventOledInverseColor);
    pageSetting->AddItem(pageSetting, "FilpScreen", ITEM_SWITCH, Switch_space[SwitchSpace_SetScreenFlip], EventOledSetScreenFlipMode);
    pageSetting->AddItem(pageSetting, "LightLevel", ITEM_CHANGE_VALUE, &ScreenBrightness, Oled_EventUpdateOledLightLevel);
    pageSetting->AddItem(pageSetting, "BeepEnable", ITEM_SWITCH, &BeeperEnable_flag, EventBeeperEnableConfig);
    pageSetting->AddItem(pageSetting, "Page2List", ITEM_SWITCH, &PageListMode_flag, NULL);
    pageSetting->AddItem(pageSetting, "Volume Ctrl", ITEM_CHANGE_VALUE, Slide_space[Slide_space_Volume_Ctrl].val, EventBeeperVolumeControl);
    pageSetting->AddItem(pageSetting, "SaveAll", ITEM_CALL_FUNCTION, EventSaveSettingConfig);

    pageSetting->AddItem(pageSetting, "Exit", ITEM_JUMP_PAGE)
        ->SetJumpId(pageMain->pageId, 0);

    // PageAnimation
    pageAnimation->AddItem(pageAnimation, "Animation", ITEM_PAGE_DESCRIPTION);
    pageAnimation->AddItem(pageAnimation, "SmoothAnim", ITEM_SWITCH, &SmoothAnimation_Flag, NULL);
    pageAnimation->AddItem(pageAnimation, "-PlsSetSpeed--", ITEM_PAGE_DESCRIPTION);
    pageAnimation->AddItem(pageAnimation, "Fre_x", ITEM_CHANGE_VALUE, &frame_x_speed, NULL);
    pageAnimation->AddItem(pageAnimation, "Fre_y", ITEM_CHANGE_VALUE, &frame_y_speed, NULL);
    pageAnimation->AddItem(pageAnimation, "Fre_width", ITEM_CHANGE_VALUE, &frame_width_speed, NULL);
    pageAnimation->AddItem(pageAnimation, "Slidbar_y", ITEM_CHANGE_VALUE, &slidbar_y_speed, NULL);
    pageAnimation->AddItem(pageAnimation, "list_y", ITEM_CHANGE_VALUE, &page_y_forlist_speed, NULL);
    pageAnimation->AddItem(pageAnimation, "icon_x", ITEM_CHANGE_VALUE, &page_x_foricon_speed, NULL);
    pageAnimation->AddItem(pageAnimation, "Exit", ITEM_JUMP_PAGE)
        ->SetJumpId(pageMain->pageId, 2);

    // PagePID
    pagePID->AddItem(pagePID, "PID Editor", ITEM_PAGE_DESCRIPTION);
    pagePID->AddItem(pagePID, "PID_Kp", ITEM_CHANGE_VALUE, &val1, NULL);
    pagePID->AddItem(pagePID, "PID_Ki", ITEM_CHANGE_VALUE, &val2, NULL);
    pagePID->AddItem(pagePID, "PID_Kd", ITEM_CHANGE_VALUE, &val3, NULL);
    pagePID->AddItem(pagePID, "Exit", ITEM_JUMP_PAGE)
        ->SetJumpId(pageSetting->pageId, 1);

    // PageWS2812
    pageWS2812->AddItem(pageWS2812, "WS2812RGBSet", ITEM_PAGE_DESCRIPTION);
    pageWS2812->AddItem(pageWS2812, "SetRed", ITEM_CHANGE_VALUE, &WS2812_R, EventWS2812ColorControl);
    pageWS2812->AddItem(pageWS2812, "SetGreen", ITEM_CHANGE_VALUE, &WS2812_G, EventWS2812ColorControl);
    pageWS2812->AddItem(pageWS2812, "SetBlue", ITEM_CHANGE_VALUE, &WS2812_B, EventWS2812ColorControl);
    pageWS2812->AddItem(pageWS2812, "Exit", ITEM_JUMP_PAGE)
        ->SetJumpId(pageMain->pageId, 7);

    // ItemTail = ItemHead;
    // while(ItemTail != NULL)
    // {
    //     printf("name:%s\r\n", ItemTail->title);
    //     printf("lid:%d\r\n", ItemTail->lineId);
    //     printf("id:%d\r\n", ItemTail->itemId);
    //     ItemTail = ItemTail->next;
    // }
    // pageTail = pageHead;
    // while(pageTail != NULL)
    // {
    //     printf("name:%s\r\n", pageTail->title);
    //     printf("id:%d\r\n", pageTail->pageId);
    //     pageTail = pageTail->next;
    // }

    printf("malloc used:%d\r\n", my_mem_perused(SRAMIN));
    printf("itemMax:%d\r\n", pageSetting->itemMax);
}

/* Little Event */
/* 对于SSD1306型号的Oled的调节屏幕亮度的函数 */
void EventUpdateOledLightLevel(void)
{
    WriteCmd(0x81);                                                    /*contrast control*/
    WriteCmd((uint8_t)*Slide_space[Slide_space_ScreenBrightness].val); /*255*/
}

/* Oled设置屏幕翻转的函数 */
void EventOledSetScreenFlipMode(void)
{
    if (*Switch_space[SwitchSpace_SetScreenFlip] == true)
    {
        Oled_u8g2_SetFlipMode(2);
    }
    else
    {
        Oled_u8g2_SetFlipMode(0);
    }
}

/* 蜂鸣器使能事件函数 */
void EventBeeperEnableConfig(void)
{
    Beeper0.Beeper_Enable = BeeperEnable_flag;
}

/* 蜂鸣器音量控制事件函数 */
void EventBeeperVolumeControl(void)
{
    Beeper0.Sound_Loud = (uint8_t)BeeperLoud;
}

/* RGB灯珠颜色控制事件函数 */
void EventWS2812ColorControl(void)
{
//    WS2812B_Write_24Bits(1, (uint32_t)((uint16_t)WS2812_G << 16 | (uint16_t)WS2812_R << 8 | (uint16_t)WS2812_B));
//    WS2812B_Show();
}

/* Large Event */

/* 陀螺仪事件函数 */
void EventShowGyroUI(void)
{
    static uint8_t EventEnter_flag = 1;
    if (EventEnter_flag)
    {
        Oled_u8g2_DrawBox(0, 0, SCREEN_WIDTH, SCREEN_HEIGHT);
        if (HugoUI_Animation_Blur() == 0)
            EventEnter_flag = 0;
        return;
    }
    Oled_u8g2_ShowUTF8(0, FONT_HEIGHT * 2.5f, "没有函数,请返回!");
    if (ui_Key_num == 2)
    {
        EventEnter_flag = 1;
        icon_move_x = 128; // 倘若跳转到custom界面可以起到一个复位动效
    }
}

/* About的应用事件函数 */
void EventShowAboutUI(void)
{
    static float motion_a = 80.0f, motion_a_trg = 0;
    // Oled_SetOledInverseColor(1);
    Oled_u8g2_ShowBMP(motion_a, 0, 40, 50, HeadSculpture_BMP);
    Oled_u8g2_ShowStr(50, FONT_HEIGHT, "HOPE  Pro");
    Oled_u8g2_ShowUTF8(45, FONT_HEIGHT * 2, "版本: Ver1.3");
    Oled_u8g2_ShowUTF8(45, FONT_HEIGHT * 3, "储存: 16 MB");
    Oled_u8g2_ShowUTF8(10, FONT_HEIGHT * 4, " By @kkl_aka科良");
    Oled_u8g2_SetDrawColor(2);
    Oled_u8g2_DrawBox(0, 0, SCREEN_WIDTH, SCREEN_HEIGHT);
    Oled_u8g2_DrawRBox(86, 3, 30, FONT_HEIGHT, 0);
    Oled_u8g2_SetDrawColor(1);

    HugoUI_Animation_Liner(&motion_a, &motion_a_trg, 85);

    if (ui_Key_num == 2)
    {
        // if (*Switch_space[SwitchSpace_OledInverseColor] == false)
        // {
        //     Oled_SetOledInverseColor(0);
        // }
        motion_a = 80.0f;
        icon_move_x = 128; // 倘若跳转到custom界面可以起到一个复位动效
    }
}

extern uint8_t peakfound_flag;

/* 血氧仪事件函数 */
void EventPulseOximeter(void)
{
    Oled_DrawSlowBitmapResize2(10, 10, Man_R_0, 8, 8, 32, 32);
    // Oled_DrawSlowBitmapResize(10, 10, Man_R_0, 8, 8,32,32);
    // u8g2_DrawXBM(&u8g2, 10, 10, 8, 8, Man_R_0);
}

/* TreasureBox的事件函数 */
void EventTreasureBox(void)
{
    Oled_DrawIntensiveComputing();
}

// width: 16, height: 16
/* 波形绘制的测试事件函数 */
void EventChartTest(void)
{ // Oled_DrawIntensiveComputing();
    static float a = 0, a_trg = 64;
    if (a == a_trg)
    {
        if (a == 0)
        {
            a_trg = 64;
        }
        else if (a == 64)
            a_trg = 0;
    }
    HugoUI_Animation_Liner(&a, &a_trg, 30);

    // Oled_DrawSlowBitmapResize(80 - a / 2, 16 - a / 4, LittleHreat_BMP, 16, 16, a / 1.5f, a / 1.5f);

    // Oled_DrawSlowBitmapResize(32 - a / 2, 32 - a / 4, Poet_BMP, 32, 32, 42, 42);
    // u8g2_SetBitmapMode(&u8g2, 0);
    // u8g2_DrawXBMP(&u8g2, 100, 0, 16, 16, LittleHreat_BMP);

    // u8g2_SetBitmapMode(&u8g2, 1);

    u8g2_DrawXBMP(&u8g2, 50, 12, 32, 32, Lighting_BMP);

    u8g2_SetDrawColor(&u8g2, 2);
    u8g2_DrawXBMP(&u8g2, 50, 20, 32, 32, Poet_BMP);
    u8g2_SetDrawColor(&u8g2, 1);

    // u8g2_SetBitmapMode(&u8g2, 0);

    if (ui_Key_num == 2)
    {
        a = 0;
        icon_move_x = 128; // 倘若跳转到custom界面可以起到一个复位动效
    }
    //	static int16_t Chart_x = 0, Chart_x_trg = 0;
    //	static int16_t Chartbox_a = 0, Chartbox_a_trg = 20;
    //	static int16_t Chartbox_width = 128, Chartbox_width_trg = 88;
    //	static int16_t Chartbox_height = 74, Chartbox_height_trg = 43;
    //	static uint32_t LastMoment = 0;
    //	static int16_t Wave[78];
    //	static uint8_t Wave_x = 0;
    //	/* 功能实现 */
    //
    //	if(Time_10ms - LastMoment > 1)
    //	{
    //		int32_t IRac;
    //		Wave_x ++;
    //		PulseOximeter_proc_ReturnParam(&IRac);
    //
    //		Wave[Wave_x] = IRac/4.f;
    //		LastMoment = Time_10ms;
    //		if(Wave_x > 78) Wave_x = 0;
    //	}
    //
    ////	if(EncoderNum == 1) Wave[Wave_x]+=3;
    ////	if(EncoderNum == 2) Wave[Wave_x]-=2;
    //
    //	/* 图形界面 */
    //
    //	// 标题
    //	Oled_u8g2_ShowStr(20, 13, "Wave-t:");
    //
    //	//绘制波形
    //	for(uint8_t i = 1; i < 79; i++)
    //	{
    //		Oled_u8g2_DrawLine(i-1 + 25, Wave[i-1] + 41, i + 25, Wave[i] + 41);
    //	}
    //
    //
    //	Oled_u8g2_DrawLine(Wave_x + 25, 59, Wave_x + 25, 61); // 当前运行指示标
    //
    //	// 绘制坐标轴
    //	Oled_u8g2_DrawLine(25, 25, 25, 58); // 竖轴
    //	Oled_u8g2_DrawLine(25, 25, 22, 28); // 箭头
    //	Oled_u8g2_DrawLine(25, 58, 103, 58); // 横轴
    //	Oled_u8g2_DrawLine(103, 58, 100, 61); // 箭头
    //
    //
    //	// 绘制聚焦框框
    //	Oled_u8g2_SetDrawColor(2);
    ////	Oled_u8g2_DrawRBox(20, 20, 88, 44, 4);
    //	Oled_u8g2_DrawRBox(Chartbox_a, Chartbox_a, Chartbox_width, Chartbox_height, 4); // 聚焦框框
    //	Oled_u8g2_SetDrawColor(1);
    //
    //	HugoUI_Run(&Chart_x, &Chart_x_trg, 2, 8);
    //	HugoUI_Run(&Chartbox_a, &Chartbox_a_trg, 2, 8);
    //	HugoUI_Run(&Chartbox_height, &Chartbox_height_trg, 3, 8);
    //	HugoUI_Run(&Chartbox_width, &Chartbox_width_trg, 3, 8);
    //
    //	if(KeyNum == 2)
    //	{
    //		Chart_x = 0;
    //		Chartbox_a = 0;
    //		Chartbox_width = 128;
    //		Chartbox_height = 74;
    //	}
}

void EventBlueTeeth(void)
{
    static uint8_t BluteethInit_flag = 1;
    static uint8_t BluteethFuncEnter_flag = 1;
    static float img_a = 4, img_a_trg = 24;

    if (BluteethInit_flag)
    {
        USART6_Init(115200);

        BluteethInit_flag = 0;
    }
    if (BluteethFuncEnter_flag)
    {
        Oled_u8g2_DrawBox(0, 0, SCREEN_WIDTH, SCREEN_HEIGHT);
        if (HugoUI_Animation_Blur() == 0)
            BluteethFuncEnter_flag = 0;
        return;
    }

    if (PCin(8) == 0)
    {
        Oled_u8g2_ShowStr(100, FONT_HEIGHT, "ERR");
    }
    else
    {
        Oled_u8g2_ShowStr(100, FONT_HEIGHT, "OK");
    }

    Oled_u8g2_ShowStr(0, FONT_HEIGHT, "Blueteeth-test:");
    Oled_u8g2_ShowStr(0, 2 * FONT_HEIGHT, "RX:");

    Oled_u8g2_ShowUTF8(0, 3 * FONT_HEIGHT, USART6_RX_BUF);

    if (img_a == img_a_trg)
    {
        if (img_a == 4)
        {
            img_a_trg = 24;
        }
        else if (img_a == 24)
            img_a_trg = 4;
    }
    HugoUI_Animation_EasyIn(&img_a, &img_a_trg, 100);

    Oled_DrawSlowBitmapResize(118 - img_a / 2, 50 - img_a / 4, Knife_BMP, 32, 32, img_a, img_a);

    if (ui_Key_num == 1)
    {
        USART6_SendBuf("Hello");
    }
    else if (ui_Key_num == 2)
    {
        img_a = 4;
        BluteethFuncEnter_flag = 1;
        icon_move_x = 128; // 倘若跳转到custom界面可以起到一个复位动效
    }
}
